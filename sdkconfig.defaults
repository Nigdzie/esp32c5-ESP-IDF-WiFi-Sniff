## sdkconfig.defaults
```kconfig
# Use 8MB flash
CONFIG_ESPTOOLPY_FLASHSIZE_8MB=y

# Use DIO mode for compatibility
CONFIG_ESPTOOLPY_FLASHMODE_DIO=y

# Use max flash frequency
CONFIG_ESPTOOLPY_FLASHFREQ_80M=y

# Partition table - single app
CONFIG_PARTITION_TABLE_SINGLE_APP=y
CONFIG_PARTITION_TABLE_OFFSET=0x8000

# Logging level
CONFIG_LOG_DEFAULT_LEVEL_INFO=y

# Enable UART RX ring buffer in IRAM
CONFIG_UART_ISR_IN_IRAM=y

# FATFS support for SD
CONFIG_FATFS_CODEPAGE_437=y
CONFIG_FATFS_LFN_NONE=y
CONFIG_FATFS_FS_LOCK=0
CONFIG_FATFS_TIMEOUT_MS=10000

# UART driver logs
CONFIG_UART_ISR_IN_IRAM=n

# Bootloader logging
CONFIG_BOOTLOADER_LOG_LEVEL_WARN=y
CONFIG_BOOTLOADER_LOG_LEVEL_INFO=
CONFIG_LOG_DEFAULT_LEVEL_ERROR=y
CONFIG_BOOTLOADER_LOG_COLORS=y
```
